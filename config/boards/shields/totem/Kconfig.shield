## config/boards/shields/totem/Kconfig.shield
```kconfig
# Copyright (c) 2022 The ZMK Contributors
# SPDX-License-Identifier: MIT

config SHIELD_TOTEM_LEFT
    def_bool $(shields_list_contains,totem_left)

config SHIELD_TOTEM_RIGHT
    def_bool $(shields_list_contains,totem_right)

config SHIELD_TOTEM_BTLEFT
    def_bool $(shields_list_contains,totem_btleft)

config SHIELD_TOTEM_BTRIGHT
    def_bool $(shields_list_contains,totem_btright)

config SHIELD_TOTEM_DONGLE
	def_bool $(shields_list_contains,totem_dongle)
```
